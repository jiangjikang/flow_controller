## board/Kconfig
```kconfig
menu "Hardware Drivers Config"

config SOC_STM32H750VB
    bool
    select SOC_SERIES_STM32H7
    select RT_USING_COMPONENTS_INIT
    select RT_USING_USER_MAIN
    default y

menu "Onboard Peripheral Drivers"
    config BSP_USING_TIM1
        bool "Enable Timer1 (hwtimer)"
        select RT_USING_HWTIMER
        default n
    config BSP_USING_TIM2
        bool "Enable Timer2 (hwtimer)"
        select RT_USING_HWTIMER
        default n
    config BSP_USING_TIM3
        bool "Enable Timer3 (hwtimer)"
        select RT_USING_HWTIMER
        default n
        
    config BSP_USING_ADC1
        bool "Enable ADC1"
        select RT_USING_ADC
        default n

    config BSP_USING_ADC2
        bool "Enable ADC2"
        select RT_USING_ADC
        default n

endmenu


menu "On-chip Peripheral Drivers"

    config BSP_USING_GPIO
        bool "Enable GPIO"
        select RT_USING_PIN
        default y

    menuconfig BSP_USING_UART
        bool "Enable UART"
        default y
        select RT_USING_SERIAL
        if BSP_USING_UART
            config BSP_USING_UART1
                bool "Enable UART1"
                default y
            config BSP_USING_UART2
                bool "Enable UART2"
                default y
            config BSP_USING_UART3
                bool "Enable UART3"
                default y
            config BSP_USING_UART4
                bool "Enable UART4"
                default y
            config BSP_USING_UART6
                bool "Enable UART6"
                default y
            config BSP_USING_UART7
                bool "Enable UART7"
                default y

        endif

    menuconfig BSP_USING_SPI
        bool "Enable SPI"
        default n
        select RT_USING_SPI
        if BSP_USING_SPI
            config BSP_USING_SPI1
                bool "Enable SPI1"
                default n
            config BSP_USING_SPI2
                bool "Enable SPI2"
                default n
            config BSP_USING_SPI4
                bool "Enable SPI4"
                default n
        endif
        
    source "libraries/HAL_Drivers/Kconfig"
    
endmenu

menu "Board extended module Drivers"

endmenu
 
endmenu
```
